/*  
*/
 #include <ESP8266WiFi.h>        //                                              
 #include <ESP8266HTTPClient.h>

#include <Arduino.h>
#include <U8g2lib.h>
#ifdef U8X8_HAVE_HW_SPI
#include <SPI.h>
#endif
#ifdef U8X8_HAVE_HW_I2C
#include <Wire.h>
#endif
///////////////////////////////pruebas ldr y led de la pantalla
#define PINLED D1
const int ldrPin = A0;
//////////////////////


////////////////////////////  casco de mando
#define u8g2_logo_97x51_width 128
#define u8g2_logo_97x51_height 62
static const unsigned char u8g2_logo_97x51_bits[] U8X8_PROGMEM = {
0x00, 0x00, 0x00, 0x00, 0x00, 0x00, 0x00, 0x00, 0x00, 0x00, 0x00, 0x00,
   0x00, 0x00, 0x00, 0x00, 0x00, 0x00, 0x00, 0x00, 0x00, 0x00, 0x00, 0x00,
   0x00, 0x00, 0x00, 0x00, 0x00, 0x00, 0x00, 0x00, 0x00, 0x00, 0x00, 0x00,
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   0x00, 0x00, 0x00, 0x00, 0x00, 0x00, 0x00, 0x00 };
////////////////////////////
#define star_wars2_negativo_width 128
#define star_wars2_negativo_height 62
static unsigned char star_wars2_negativo_bits[] = {
   0xff, 0xff, 0xff, 0xff, 0xff, 0xff, 0xff, 0xff, 0xff, 0xff, 0xff, 0xff,
   0xff, 0xff, 0xff, 0xff, 0xff, 0xff, 0xff, 0xff, 0xff, 0xff, 0xff, 0xff,
   0xff, 0xff, 0xff, 0xff, 0xff, 0xff, 0xff, 0xff, 0xff, 0xff, 0xff, 0xff,
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   0xff, 0xff, 0xff, 0xff, 0xff, 0xff, 0xff, 0xff };

#define mando3_width 66
#define mando3_height 64
static unsigned char mando3_bits[] = {
   0x00, 0x00, 0x00, 0x00, 0x00, 0x00, 0x00, 0x00, 0x00, 0x00, 0x00, 0x00,
   0x00, 0x00, 0x00, 0x00, 0x00, 0x00, 0x00, 0x00, 0x00, 0xe0, 0x1f, 0x00,
   0x00, 0x00, 0x00, 0x00, 0x00, 0x00, 0xee, 0xdf, 0x03, 0x00, 0x00, 0x00,
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   0x00, 0x00, 0x00, 0x00, 0x00, 0x00, 0x00, 0x00, 0x00, 0x00, 0x00, 0x00 };


#define IRON_MAN_02_width 42
#define IRON_MAN_02_height 64
static unsigned char IRON_MAN_02_bits[] = {
   0x00, 0x00, 0x00, 0x00, 0x00, 0x00, 0x00, 0x00, 0xff, 0x03, 0x00, 0x00,
   0x00, 0xf0, 0xff, 0x3f, 0x00, 0x00, 0x00, 0xfe, 0xff, 0xff, 0x00, 0x00,
   0x00, 0xff, 0xff, 0xff, 0x03, 0x00, 0xc0, 0xc7, 0xff, 0x87, 0x07, 0x00,
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   0x00, 0xe0, 0xff, 0x1f, 0x00, 0x00, 0x00, 0x00, 0x00, 0x00, 0x00, 0x00 };

 #define arduino_width 94
 #define arduino_height 64
 static unsigned char arduino_bits[] = {
   0x00, 0x00, 0x00, 0x00, 0x00, 0x00, 0x00, 0x00, 0x00, 0x00, 0x00, 0x00,
   0x00, 0x00, 0xfc, 0x0f, 0x00, 0x00, 0x00, 0x00, 0xfe, 0x0f, 0x00, 0x00,
   0x00, 0x80, 0xff, 0x7f, 0x00, 0x00, 0x00, 0xc0, 0xff, 0x3f, 0x00, 0x00,
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   0x00, 0x00, 0x00, 0x00, 0x00, 0x00, 0x00, 0x00, 0x00, 0x00, 0x00, 0x00 };


U8G2_ST7920_128X64_1_SW_SPI u8g2(U8G2_R0, /* clock=*/ 14, /* data=*/ 13, /* CS=*/ 15, /* reset=*/ 12);

  const char* ssid = "IZZI-E95C";              //WIFI SSID Name                             
  const char* password = "F0AF85DDE95C";        //WIFI Password
  const char* host = "api.thingspeak.com";  //We read the data from this host                                   
  const int httpPortRead = 80;                                           
                                                  
  const char* url1 = "https://api.thingspeak.com/apps/thinghttp/send_request?api_key=TOX2NA7SVR07MYPA";   //"https://api.thingspeak.com/apps/thinghttp/send_request?api_key=YQFWODVICKFYFMYQ";     //covid 19 mexico
  const char* url2 = "https://api.thingspeak.com/apps/thinghttp/send_request?api_key=IY9BXQQSALH829PP";   //temp chico
  const char* url3 = "https://api.thingspeak.com/apps/thinghttp/send_request?api_key=UAVJYZGHYCOAXUKQ";   //hora
  const char* url4 = "https://api.thingspeak.com/apps/thinghttp/send_request?api_key=2591M18E0Y1HL7SQ";   //noticias
  const char* url5 = "https://api.thingspeak.com/apps/thinghttp/send_request?api_key=E79O6AQIBH1H2ASF";   //excelsior
  const char* url6 = "https://api.thingspeak.com/apps/thinghttp/send_request?api_key=QQV2D5DZ5OCEXRGQ";   //FECHA
  const char* url7 = "https://api.thingspeak.com/apps/thinghttp/send_request?api_key=B60VAO1JQ1AQTHSM";   //Humes
  const char* url8 = "https://api.thingspeak.com/channels/1110050/feeds.json?results=2";   //TEMP INTERNA
  int To_remove;      //There are some irrelevant data on the string and here's how I keep the index
                      //of those characters 
 String Cases,Versiculo,Recovered,temp,reloj,noti,excel,fecha,Hume,Temp_int,Data_Raw,Data_Raw_1,Data_Raw_2,Data_Raw_3,Data_Raw_4,Data_Raw_5,Data_Raw_6,Data_Raw_7,Data_Raw_8,Data_Raw_9,Data_Raw_10,Data_Raw_11;  //Aquí se guarda los números que se tengan

  WiFiClient client;      //Create a WiFi client and http client                                                     
  HTTPClient http; 
/////////////////////////////////////////////////////////////////////////////////////
// Global data
int cont = 0;
//////////////////////////////////////////////////////////////////////////////////

  void setup() {
///////////////////////////////pruebas ldr y led de la pantalla
     pinMode(PINLED,OUTPUT);
     pinMode(ldrPin, INPUT);
    Serial.begin(115200);
    WiFi.disconnect();             //Desconecta y vuelve a conectarte al Wifi que configuraste                                                 
    delay(1000);                                                                  
    WiFi.begin(ssid, password);                                                   
    Serial.println("Connected to the WiFi network");   //Mostrar comentarios en el monitor en serial                                      
    Serial.println(WiFi.localIP());
u8g2.begin();  ///lcd
u8g2.enableUTF8Print();

///////////////////////////////
analogWrite(PINLED, 500);
////////////////////////////// intro INTRO
  for (int r = 0; r <= 5; r++) {
    logo(300);
    star(300);
  }
//////////////////////////////
  }

  uint8_t m = 16;

void loop() {
    Brillo();
/////////////////////////////////////////////////////////////////////////////////////////////Versiculo de la Biblia diario 
   //Reading 1: Reading of cases
    if( http.begin(host,httpPortRead,url1))        //Connect to the host and the url                                      
      {
        int httpCode = http.GET();                //Check feedback if there's a response                                                  
        if (httpCode > 0)                                                              
        {
          if (httpCode == HTTP_CODE_OK || httpCode == HTTP_CODE_MOVED_PERMANENTLY) 
            {                
              
              Data_Raw = http.getString();   //Here we store the raw data string
            
              
              Data_Raw_1 = Data_Raw;                                    
              To_remove = Data_Raw_1.indexOf("mb2");                   // Busco la posición de este símbolo ">"                                 
              Data_Raw_1.remove(0,To_remove+5);                      // Lo quito y todo lo que hay antes
              To_remove = Data_Raw_1.indexOf("</p>");                   // Busco la posición de este símbolo ">"                                
              Data_Raw_1.remove(To_remove,Data_Raw_1.length());      // Lo quito y todo lo que sigue
                                                                     // Ejemplo: estos son los datos sin procesar recibidos <td style = "font-weight: bold; text-align: right"> 63,927 </td>
                                                                     // Primero buscamos ">" y eliminamos todo lo anterior incluyéndolo
                                                                     // Nos quedamos con esto 63,927 </td>
                                                                     // Buscamos el símbolo "<" y lo quitamos + todo después
                                                                     // Solo guardamos esto 63,927 como cadena
              Data_Raw_1.replace("á","a");
              Data_Raw_1.replace("ñ","n");  
              Data_Raw_1.replace("í","i"); 
              Data_Raw_1.replace("ó","o"); 
              Data_Raw_1.replace("é","e");
              Data_Raw_1.replace("ú","u");  
              Data_Raw_1.replace("“","'");                                          
              Data_Raw_1.replace("”","'");
                             
              Cases=Data_Raw_1;
              Serial.print("Versiculo: ");  //Elegi mostrarlo en el monitor de serie para ayudarte a depurar
              Serial.println(Cases); 
              
              Data_Raw_2=Data_Raw;
              To_remove = Data_Raw_2.indexOf("ttu");
              Data_Raw_2.remove(0,To_remove+5);
              Data_Raw_3=Data_Raw_2;
              To_remove = Data_Raw_2.indexOf("(RVR");
              Data_Raw_2.remove(To_remove,Data_Raw_2.length());

              Data_Raw_2.replace("á","a");
              Data_Raw_2.replace("ñ","n");  
              Data_Raw_2.replace("í","i"); 
              Data_Raw_2.replace("ó","o"); 
              Data_Raw_2.replace("é","e");
              Data_Raw_2.replace("ú","u");  
              Data_Raw_2.replace("“","'");                                          
              Data_Raw_2.replace("”","'"); 

              Versiculo=Data_Raw_2;
              //Serial.print("Biblia: ");
              //Serial.println(Versiculo);
                                                                        
            }
        }
        else //If we can't get data
        {
          Serial.printf("[HTTP] GET... failed, error: %s\n", http.errorToString(httpCode).c_str());
        }
        
        http.end();                                                                 
      } 
      ////////////////////////////////////////////////////////////////////////////////////////////////////////////////temp chico
          if( http.begin(host,httpPortRead,url2))        //Connect to the host and the url                                      
      {
        int httpCode2 = http.GET();                //Check feedback if there's a response                                                  
        if (httpCode2 > 0)                                                              
        {
          if (httpCode2 == HTTP_CODE_OK || httpCode2 == HTTP_CODE_MOVED_PERMANENTLY) 
            {                
              
              Data_Raw = http.getString();   //Here we store the raw data string
            
              
              Data_Raw_4 = Data_Raw;                                    
              To_remove = Data_Raw_4.indexOf(">");                   // Busco la posición de este símbolo ">"                                 
              Data_Raw_4.remove(0,To_remove+1);                      // Lo quito y todo lo que hay antes
              To_remove = Data_Raw_4.indexOf("</");                   // Busco la posición de este símbolo ">"                                
              Data_Raw_4.remove(To_remove,Data_Raw_4.length());      // Lo quito y todo lo que sigue
                                                                     // Ejemplo: estos son los datos sin procesar recibidos <td style = "font-weight: bold; text-align: right"> 63,927 </td>
                                                                     // Primero buscamos ">" y eliminamos todo lo anterior incluyéndolo
                                                                     // Nos quedamos con esto 63,927 </td>

              Data_Raw_4.replace("°","");
              temp=Data_Raw_4;
              Serial.print("temp: ");  //I choosed to display it on the serial monitor to help you debug
              Serial.println(temp); 
                                                                                       
            }
        }
        else //If we can't get data
        {
          Serial.printf("[HTTP] GET... failed, error: %s\n", http.errorToString(httpCode2).c_str());
        }
        
        http.end();                                                                 
      } 

      ////////////////////////////////////////////////////////////////////////////////////////////////////////////////Reloj
          if( http.begin(host,httpPortRead,url3))        //Connect to the host and the url                                      
      {
        int httpCode3 = http.GET();                //Check feedback if there's a response                                                  
        if (httpCode3 > 0)                                                              
        {
          if (httpCode3 == HTTP_CODE_OK || httpCode3 == HTTP_CODE_MOVED_PERMANENTLY) 
            {                
              
              Data_Raw = http.getString();   //Here we store the raw data string
            
              
              Data_Raw_5 = Data_Raw;                                    
              To_remove = Data_Raw_5.indexOf(">");                   // Busco la posición de este símbolo ">"                                 
              Data_Raw_5.remove(0,To_remove+2);                      // Lo quito y todo lo que hay antes
              To_remove = Data_Raw_5.indexOf("<");                   // Busco la posición de este símbolo ">"                                
              Data_Raw_5.remove(To_remove,Data_Raw_5.length());      // Lo quito y todo lo que sigue
                                                                     // Ejemplo: estos son los datos sin procesar recibidos <td style = "font-weight: bold; text-align: right"> 63,927 </td>
                                                                     // Primero buscamos ">" y eliminamos todo lo anterior incluyéndolo
                                                                     // Nos quedamos con esto 63,927 </td>
              
              Data_Raw_5.replace("            "," ");
              Data_Raw_5.replace(" AM          ","");
              Data_Raw_5.replace(" PM          ","");
              reloj=Data_Raw_5;
              Serial.print("Time: ");  //I choosed to display it on the serial monitor to help you debug
              Serial.println(reloj); 

             
                                                                                       
            }
        }
        else //If we can't get data
        {
          Serial.printf("[HTTP] GET... failed, error: %s\n", http.errorToString(httpCode3).c_str());
        }
        
        http.end();                                                                 
      } 

    
      ////////////////////////////////////////////////////////////////////////////////////////////////////////////////fecha dia/mes/año
          if( http.begin(host,httpPortRead,url6))        //Connect to the host and the url                                      
      {
        int httpCode6 = http.GET();                //Check feedback if there's a response                                                  
        if (httpCode6 > 0)                                                              
        {
          if (httpCode6 == HTTP_CODE_OK || httpCode6 == HTTP_CODE_MOVED_PERMANENTLY) 
            {                
              
              Data_Raw = http.getString();   //Here we store the raw data string
            
              
              Data_Raw_9 = Data_Raw;                                    
              To_remove = Data_Raw_9.indexOf(">");                   // Busco la posición de este símbolo ">"                                 
              Data_Raw_9.remove(0,To_remove+5);                      // Lo quito y todo lo que hay antes
              To_remove = Data_Raw_9.indexOf("<");                   // Busco la posición de este símbolo ">"                                
              Data_Raw_9.remove(To_remove,Data_Raw_9.length());      // Lo quito y todo lo que sigue
                                                                     // Ejemplo: estos son los datos sin procesar recibidos <td style = "font-weight: bold; text-align: right"> 63,927 </td>
                                                                     // Primero buscamos ">" y eliminamos todo lo anterior incluyéndolo
                                                                     // Nos quedamos con esto 63,927 </td>

             // Data_Raw_9.replace("°","c");
             Data_Raw_9 = Data_Raw;                            
             Data_Raw_9.replace("á","a");
             Data_Raw_9.replace("ñ","n");  
             Data_Raw_9.replace("í","i"); 
             Data_Raw_9.replace("ó","o"); 
             Data_Raw_9.replace("é","e");
             Data_Raw_9.replace("ú","u");  
             Data_Raw_9.replace("“","'");                                          
             Data_Raw_9.replace("”","'");
             Data_Raw_9.replace("</span>"," ");
             Data_Raw_9.replace("<span>",""); ///  Data_Raw_9.replace("<span>","Fecha: "); 
             fecha=Data_Raw_9;
              Serial.print("fecha: ");  //I choosed to display it on the serial monitor to help you debug
              Serial.println(fecha); 
                                                                                       
            }
        }
        else //If we can't get data
        {
          Serial.printf("[HTTP] GET... failed, error: %s\n", http.errorToString(httpCode6).c_str());
        }
        
        http.end();                                                                 
      } 

      ////////////////////////////////////////////////////////////////////////////////////////////////////////////////Humedad.
          if( http.begin(host,httpPortRead,url7))        //Connect to the host and the url                                      
      {
        int httpCode7 = http.GET();                //Check feedback if there's a response                                                  
        if (httpCode7 > 0)                                                              
        {
          if (httpCode7 == HTTP_CODE_OK || httpCode7 == HTTP_CODE_MOVED_PERMANENTLY) 
            {                
              
              Data_Raw = http.getString();   //Here we store the raw data string
            
              
              Data_Raw_10 = Data_Raw;                                    
              To_remove = Data_Raw_10.indexOf(">");                   // Busco la posición de este símbolo ">"                                 
              Data_Raw_10.remove(0,To_remove+1);                      // Lo quito y todo lo que hay antes
              To_remove = Data_Raw_10.indexOf("<");                   // Busco la posición de este símbolo ">"                                
              Data_Raw_10.remove(To_remove,Data_Raw_10.length());      // Lo quito y todo lo que sigue
                                                                     // Ejemplo: estos son los datos sin procesar recibidos <td style = "font-weight: bold; text-align: right"> 63,927 </td>
                                                                     // Primero buscamos ">" y eliminamos todo lo anterior incluyéndolo
                                                                     // Nos quedamos con esto 63,927 </td>


              Hume=Data_Raw_10;
              Serial.print("Hume: ");  //I choosed to display it on the serial monitor to help you debug
              Serial.println(Hume); 
                                                                                       
            }
        }
        else //If we can't get data
        {
          Serial.printf("[HTTP] GET... failed, error: %s\n", http.errorToString(httpCode7).c_str());
        }
        
        http.end();                                                                 
      } 

////////////////////////////////////////////////////////////////////////////////////////////////////////////////temp Interna
          if( http.begin(host,httpPortRead,url8))        //Connect to the host and the url                                      
      {
        int httpCode7 = http.GET();                //Check feedback if there's a response                                                  
        if (httpCode7 > 0)                                                              
        {
          if (httpCode7 == HTTP_CODE_OK || httpCode7 == HTTP_CODE_MOVED_PERMANENTLY) 
            {                
              
              Data_Raw = http.getString();   //Here we store the raw data string
            
              
              Data_Raw_11 = Data_Raw;
                                              
              To_remove = Data_Raw_11.indexOf("entry_id");                   // Busco la posición de este símbolo ">"                                 
              Data_Raw_11.remove(0,To_remove+90);                      // Lo quito y todo lo que hay antes
              To_remove = Data_Raw_11.indexOf("field2");                   // Busco la posición de este símbolo "<"                                
              Data_Raw_11.remove(To_remove-6,Data_Raw_11.length());      // Lo quito y todo lo que sigue
                                                                     // Ejemplo: estos son los datos sin procesar recibidos <td style = "font-weight: bold; text-align: right"> 63,927 </td>
                                                                     // Primero buscamos ">" y eliminamos todo lo anterior incluyéndolo
                                                                     // Nos quedamos con esto 63,927 </td>


              Temp_int=Data_Raw_11;
              Serial.print("Temp Interior: ");  //I choosed to display it on the serial monitor to help you debug
              Serial.println(Temp_int); 
                                                                                       
            }
        }
        else //If we can't get data
        {
          Serial.printf("[HTTP] GET... failed, error: %s\n", http.errorToString(httpCode7).c_str());
        }
        
        http.end();                                                                 
      } 

      ////////////////////////////////////////////////////////////////////////////////////////////////////////
      
      
    else //If we can't connect to the HTTP
      {
        Serial.printf("[HTTP} Unable to connect\n");
      }

    while (WiFi.status() != WL_CONNECTED)     //In case the Wifi connexion is lost                                    
      { 
        
        WiFi.disconnect();                                                        
        delay(1000);                                                             
        
        WiFi.begin(ssid, password);                                              
        Serial.println("Reconnecting to WiFi..");       
        delay(10000);                                                             
      }
///////////////////////////////////
              Serial.print("Muertes: ");
              Serial.println(Versiculo);
    char str1[50];
    char str2[200];
    Brillo();
 //strcpy (str2, (char*) reloj.c_str());
//////////////////////////////////////////


cont = cont +1;
//Serial.println(cont);
if (cont == 10) {
    int casos = random(1,6);
    Serial.println(casos);
  switch (casos) { 
  case 1:   logo(3000);  break;  //sale del switch
  case 2:   star(3000);  break;  //sale del switch  
  case 3:   mando(3000); break;  //sale del switch  
  case 4:  ironman(3000); break;  
  case 5:  arduinologo(3000); break;   
  default:  Serial.println("algo anda mal"); break;  //sale del switch
}
  cont = 0;
}
  u8g2.firstPage();
  Serial.println(Versiculo);
  do {
 
/////////////////////////////////////////////////Reloj
    u8g2.setFont(u8g2_font_logisoso22_tr);
    u8g2.drawStr(12,23,(char*) reloj.c_str());
/////////////////////////////////////////////////// Tempertura interna
    strcpy (str1, (char*) Temp_int.c_str());
    strcpy (str2, " °C");
    u8g2.setFont(u8g2_font_micro_tr);
    //u8g2.drawStr(85,62,(char*) Temp_int.c_str());
    u8g2.setCursor(96, 62);
    u8g2.print(strcat (str1, str2));
///////////////////////////////////////////////////led 
    //u8g2.setFont(u8g2_font_micro_tr);
     u8g2.setCursor(75, 62);
     u8g2.print(analogRead(ldrPin));
   // u8g2.drawStr(80,62,analogRead(ldrPin));
    //u8g2.drawStr(80,62,ldrStatus);
//////////////////////////////////////////////////Versiculo 
    u8g2.setFont(u8g2_font_micro_tr);
    u8g2.drawStr(1,62,(char*) Versiculo.c_str());
///////////////////////////////////////////////////fecha
    u8g2.setFont(u8g2_font_micro_tr);
    u8g2.drawStr(25,55,(char*) fecha.c_str());
    
///////////////////////////////////////////////////Humedad
    u8g2.setFont(u8g2_font_logisoso16_tf);
    u8g2.drawStr(80,46,(char*) Hume.c_str());
//////////////////////////////////////////////// temperatura
    strcpy (str1, (char*) temp.c_str());
    strcpy (str2, "°C");
    u8g2.setFont(u8g2_font_logisoso16_tf);
    //u8g2.drawStr(1,44,strcat (str1, str2));
   // u8g2.drawStr(1,44,(char*) temp.c_str());
    u8g2.setCursor(20, 46);
    u8g2.print(strcat (str1, str2));
/////////////////////////////////////////////// ICONOS 
    u8g2.setFont(u8g2_font_open_iconic_all_2x_t);   // RELOJ 123
    u8g2.drawGlyph(6, 20, 123);  
    u8g2.setFont(u8g2_font_open_iconic_all_2x_t);   // TEMP-SOL
    u8g2.drawGlyph(2, 46, 259); 
    u8g2.setFont(u8g2_font_open_iconic_all_2x_t);   // hUMEDAD- GOTA
    u8g2.drawGlyph(64, 46, 152); 
  } while ( u8g2.nextPage() );
  delay(1);

///////////////////////////////////////
 
}

void Brillo(){

 //////////////////////////////////////pruebas ldr y led de la pantalla
 /* if ((analogRead(ldrPin)  < 50)){ analogWrite(PINLED, 100);}
  if ((analogRead(ldrPin)) > 50 and (analogRead(ldrPin) <= 100)){ analogWrite(PINLED, 200);}
  if ((analogRead(ldrPin)) > 100 and (analogRead(ldrPin) <= 400)){ analogWrite(PINLED, 300);}
  if ((analogRead(ldrPin)) > 400 and (analogRead(ldrPin) <= 700)){ analogWrite(PINLED, 400);}
  if ((analogRead(ldrPin)) > 700 and (analogRead(ldrPin) <= 900)){ analogWrite(PINLED, 500);}
  if ((analogRead(ldrPin)  > 900)){ analogWrite(PINLED, 1024);}
  Serial.println(analogRead(ldrPin));
*/
  if ((analogRead(ldrPin)  < 30)){ analogWrite(PINLED, 100);}
  if ((analogRead(ldrPin)) > 30 and (analogRead(ldrPin) <= 50)){ analogWrite(PINLED, 200);}
  if ((analogRead(ldrPin)) > 50 and (analogRead(ldrPin) <= 200)){ analogWrite(PINLED, 300);}
  if ((analogRead(ldrPin)) > 200 and (analogRead(ldrPin) <= 500)){ analogWrite(PINLED, 400);}
  if ((analogRead(ldrPin)) > 500 and (analogRead(ldrPin) <= 700)){ analogWrite(PINLED, 500);}
  if ((analogRead(ldrPin)  > 700)){ analogWrite(PINLED, 1024);}
  Serial.println(analogRead(ldrPin));
  
/////////////////////////////////////////

}

void logo(int temp){
    u8g2.firstPage();
  do {
//analogWrite(PINLED, 500);
 u8g2.setFont(u8g2_font_ncenB14_tr);
 u8g2.drawXBMP(0,0, u8g2_logo_97x51_width, u8g2_logo_97x51_height, u8g2_logo_97x51_bits);
   } while ( u8g2.nextPage()   );
    
   delay (temp);
}

void star(int temp){
    u8g2.firstPage();
  do {
//analogWrite(PINLED, 500);
 u8g2.setFont(u8g2_font_ncenB14_tr);
 u8g2.drawXBMP(0,0, star_wars2_negativo_width, star_wars2_negativo_height, star_wars2_negativo_bits);
   } while ( u8g2.nextPage()   );
    
   delay (temp);
}

void mando(int temp){
    u8g2.firstPage();
  do {
//analogWrite(PINLED, 500);
 u8g2.setFont(u8g2_font_ncenB14_tr);
 u8g2.drawXBMP(30,0, mando3_width, mando3_height, mando3_bits);
   } while ( u8g2.nextPage()   );
    
   delay (temp);
}

void ironman(int temp){
    u8g2.firstPage();
  do {
//analogWrite(PINLED, 500);
 u8g2.setFont(u8g2_font_ncenB14_tr);
 u8g2.drawXBMP(45,0, IRON_MAN_02_width, IRON_MAN_02_height, IRON_MAN_02_bits);
   } while ( u8g2.nextPage()   );
    
   delay (temp);
}

void arduinologo(int temp){
    u8g2.firstPage();
  do {
//analogWrite(PINLED, 500);
 u8g2.setFont(u8g2_font_ncenB14_tr);
 u8g2.drawXBMP(17,0, arduino_width, arduino_height, arduino_bits);
   } while ( u8g2.nextPage()   );
    
   delay (temp);
}
